## sources/meta-stm32mp/conf/machine/include/stm32mp1.inc
```bitbake
require conf/machine/include/soc-family.inc
include conf/machine/include/arm/armv7a/tune-cortexa7.inc

DEFAULTTUNE = "cortexa7thf-neon-vfpv4"

SOC_FAMILY = "stm32mp1"

PREFERRED_PROVIDER_virtual/kernel ??= "linux-mainline"

UBOOT_SUFFIX = "img"
UBOOT_ENTRYPOINT = "0xC2000040"

SERIAL_CONSOLES = "115200;ttySTM0"
SERIAL_CONSOLES_CHECK = "${SERIAL_CONSOLES}"


# Do not update fstab file when using wic images
WIC_CREATE_EXTRA_ARGS ?= "--no-fstab-update"

# Image
IMAGE_FSTYPES = "wic wic.zst tar.zst"

WKS_FILE_DEPENDS ?= " \
    virtual/bootloader \
    e2fsprogs-native \
"

# Wic default support
WKS_FILE ?= "stm32mp157-basic.wks.in"

KERNEL_IMAGETYPE ?= "zImage"

MACHINE_FEATURES += "watchdog gpu m4copro usbg0"
```

## sources/meta-stm32mp/conf/machine/stm32mp15-disco.conf
```bitbake
#@TYPE: Machine
#@NAME: STM32MP157D-DK1
#@MAINTAINER: Marcin Bober <mbober1@gmail.com>

require conf/machine/include/stm32mp1.inc

KERNEL_DEVICETREE ?= "st/stm32mp157a-dk1.dtb"
KBUILD_DEFCONFIG = "multi_v7_defconfig"

SPL_BINARY ?= "u-boot-spl.stm32"
UBOOT_MACHINE ?= "stm32mp15_basic_defconfig"
UBOOT_EXTLINUX ?= "1"
UBOOT_EXTLINUX_KERNEL_ARGS ?= "rootwait rw rootfstype=ext4"
UBOOT_EXTLINUX_ROOT ?= "root=/dev/mmcblk0p${bootpart}"
UBOOT_EXTLINUX_CONSOLE ?= "${SERIAL_CONSOLES}"
UBOOT_EXTLINUX_FDT ?= "../stm32mp157a-dk1.dtb"

PREFERRED_PROVIDER_virtual/kernel ??= "linux-yocto"
# PREFERRED_PROVIDER_virtual/bootloader ??= "u-boot-olimex"
# PREFERRED_PROVIDER_u-boot ??= "u-boot-stm32mp"

MACHINE_ESSENTIAL_EXTRA_RDEPENDS += " \
    kernel-image \
    kernel-devicetree \
    kernel-modules \
    u-boot \
"


MACHINE_FEATURES += "usbhost usbgadget splash screen rtc serial"
```

## sources/meta-stm32mp/conf/machine/stmp157-olinuxino-lime2.conf
```bitbake
#@TYPE: Machine
#@NAME: STMP157-OLinuXino-LIME2
#@MAINTAINER: Marcin Bober <mbober1@gmail.com>
#@DESCRIPTION: Open Source Hardware Linux Computer with ST Microelectronics STM32MP157 Dual Core Cortex-A7 SOC	
#https://www.olimex.com/Products/OLinuXino/STMP1/STMP157-OLinuXino-LIME2/open-source-hardware

require conf/machine/include/stm32mp1.inc

KERNEL_DEVICETREE ?= "st/stm32mp1xx-olinuxino-lime.dtb"

SPL_BINARY ?= "u-boot-spl.stm32"
UBOOT_MACHINE ?= "STM32-OLinuXino-LIME_defconfig"
UBOOT_EXTLINUX ?= "1"
UBOOT_EXTLINUX_KERNEL_ARGS ?= "rootwait rw rootfstype=ext4"
UBOOT_EXTLINUX_ROOT ?= "root=/dev/mmcblk0p${bootpart}"
UBOOT_EXTLINUX_CONSOLE ?= "${SERIAL_CONSOLES}"
UBOOT_EXTLINUX_FDT ?= "../stm32mp1xx-olinuxino-lime.dtb"

# PREFERRED_PROVIDER_virtual/kernel ??= "linux-stm32"
PREFERRED_PROVIDER_virtual/kernel ??= "linux-torvalds-next"
# PREFERRED_PROVIDER_virtual/bootloader ??= "u-boot-olimex"
# PREFERRED_PROVIDER_u-boot ??= "u-boot-stm32mp"

MACHINE_ESSENTIAL_EXTRA_RDEPENDS += " \
    kernel-image \
    kernel-devicetree \
    kernel-modules \
    u-boot \
"


MACHINE_FEATURES += "usbhost usbgadget splash screen rtc serial"
```
